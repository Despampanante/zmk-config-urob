/* source key position labels */
#include "zmk-helpers/key-labels/34.h"

/* map Zen's extra keys */

/* activate bluetooth */
#define CONFIG_WIRELESS 1

/* source the main keymap */
#include "base.keymap"
